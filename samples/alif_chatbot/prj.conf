## CMakeLists.txt
```
# SPDX-License-Identifier: Apache-2.0

cmake_minimum_required(VERSION 3.20.0)

find_package(Zephyr REQUIRED HINTS $ENV{ZEPHYR_BASE})
project(alif_chatbot)

target_sources(app PRIVATE src/main.c)
```

## Kconfig
```
config ALIF_ENDPOINT
	string "Default API endpoint URL"
	default "http://192.0.2.2:11434/api/chat"
	help
	  The default HTTP API endpoint used for Alif chat completion
	  requests.

config ALIF_MODEL
	string "Default model name"
	default "qwen2.5:7b"
	help
	  The default AI model identifier sent to the API when making
	  chat completion requests.

config ALIF_TOKEN
	string "API authentication token"
	help
	  The API token used to authenticate requests to the Alif
	  service. This value is typically provided by the service
	  provider and should be kept secret.

source "Kconfig.zephyr"
```

## prj.conf
```kconfig
# General config
CONFIG_MAIN_STACK_SIZE=4096
CONFIG_SYSTEM_WORKQUEUE_STACK_SIZE=4096
CONFIG_INIT_STACKS=y
CONFIG_THREAD_STACK_INFO=y

# Networking config
CONFIG_NETWORKING=y
CONFIG_NET_IPV4=y
CONFIG_NET_IPV6=n
CONFIG_NET_TCP=y
CONFIG_NET_SOCKETS=y
CONFIG_NET_SOCKETS_SOCKOPT_TLS=y
CONFIG_NET_SOCKETS_CONNECT_TIMEOUT=60000

# Network address config
CONFIG_NET_CONFIG_SETTINGS=y
CONFIG_NET_CONFIG_NEED_IPV4=y
CONFIG_NET_CONFIG_MY_IPV4_ADDR="192.0.2.1"
CONFIG_NET_CONFIG_PEER_IPV4_ADDR="192.0.2.2"
CONFIG_NET_CONFIG_MY_IPV4_GW="192.0.2.2"

# TLS configuration
CONFIG_MBEDTLS=y
CONFIG_MBEDTLS_BUILTIN=y
CONFIG_MBEDTLS_ENABLE_HEAP=y
CONFIG_MBEDTLS_HEAP_SIZE=60000
CONFIG_MBEDTLS_SSL_MAX_CONTENT_LEN=7168
CONFIG_MBEDTLS_HASH_ALL_ENABLED=y

CONFIG_MBEDTLS_CIPHERSUITE_TLS_ECDHE_RSA_WITH_AES_256_GCM_SHA384=y
CONFIG_MBEDTLS_CIPHERSUITE_TLS_ECDHE_ECDSA_WITH_AES_256_GCM_SHA384=y

# Requests config
CONFIG_REQUESTS=y
CONFIG_REQUESTS_CERTIFICATE="globalsign_r1.der"

# DNS config
CONFIG_DNS_SERVER_IP_ADDRESSES=y
CONFIG_DNS_SERVER1="8.8.8.8"
CONFIG_NET_SOCKETS_DNS_TIMEOUT=5000

# Alif config
CONFIG_ALIF_TOKEN=""

# Shell config
CONFIG_SHELL=y
CONFIG_NET_SHELL=y

# Debug config
CONFIG_LOG=y
CONFIG_NET_LOG=y
```

## overlay-wifi.conf
```kconfig
# DHCP config
CONFIG_NET_DHCPV4=y
CONFIG_NET_CONFIG_SETTINGS=n
CONFIG_NET_CONFIG_NEED_IPV4=n

# Wifi config
CONFIG_WIFI=y
CONFIG_NET_L2_WIFI_SHELL=y
```

## src/main.c
```c
/*
 * Copyright (c) 2026 Muhammad Waleed Badar
 *
 * SPDX-License-Identifier: Apache-2.0
 */

#include <zephyr/kernel.h>
#include <zephyr/shell/shell.h>
#include <requests/net/lib/requests.h>

#define PROMPT_KEY "\"content\":\""

static int alif_json_parser(const char *json, const char *key, char *out, size_t out_size)
{
	const char *start = strstr(json, key);
	if (!start) {
		return -EINVAL;
	}

	start += strlen(key);
	const char *end = strchr(start, '"');
	if (!end) {
		return -EINVAL;
	}

	size_t len = end - start;
	if (len + 1 > out_size) {
		return -EINVAL;
	}

	memset(out, 0, out_size);
	memcpy(out, start, len);
	out[len] = '\0';
	return 0;
}

static int alif_response(struct http_response *rsp, enum http_final_call final_data,
			 void *user_data)
{
	struct requests_ctx *ctx = (struct requests_ctx *)user_data;

	if (rsp->http_status_code == 0) {
		shell_warn(ctx->sh, "HTTP Status Code: %d", rsp->http_status_code );
	}

	return 0;
}

static int alif_ask(const struct shell *sh, size_t argc, char **argv)
{
	int ret;
	int ssl_verifypeer = 0;

	const char *headers[] = {"User-Agent: curl/7.81.0\r\n", "Accept: */*\r\n",
				 "Content-Type: application/json\r\n",
				 "Authorization: Bearer " CONFIG_ALIF_TOKEN "\r\n", NULL};

	char prompt[512];
	int prompt_lenght = snprintf(prompt, sizeof(prompt),
				  "{\"model\":\"%s\","
				  "\"stream\": false,"
				  "\"messages\":[{\"role\":\"user\",\"content\":\"%s\"}]}",
				  CONFIG_ALIF_MODEL, argv[1]);

	struct requests_ctx ctx;
	ret = requests_init(&ctx, CONFIG_ALIF_ENDPOINT);
	if (ret < 0) {
		shell_error(sh, "Failed to initialize requests (%d)", ret);
		return ret;
	}

	requests_setopt(&ctx, REQUESTS_HTTPHEADERS, headers);
	requests_setopt(&ctx, REQUESTS_PROTOCOL, "HTTP/1.1");
	requests_setopt(&ctx, REQUESTS_SSL_VERIFYPEER, &ssl_verifypeer);
	requests_setopt(&ctx, REQUESTS_WRITEFUNCTION, alif_response);
	requests_setopt(&ctx, REQUESTS_POSTFIELDS_SIZE, &prompt_lenght);
	requests_setopt(&ctx, REQUESTS_POSTFIELDS, prompt);

	ret = requests(&ctx, HTTP_POST);
	if (ret < 0) {
		shell_error(sh, "POST request failed (%d)", ret);
		return ret;
	}

	alif_json_parser(ctx.recv_buf, PROMPT_KEY, prompt, sizeof(prompt));
	shell_print(sh, "%s", prompt);

	return 0;
}

SHELL_CMD_ARG_REGISTER(alif, NULL, SHELL_HELP("Ask Alif", "<prompt>"), alif_ask, 2, 0);
```
