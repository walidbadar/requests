## subsys/Kconfig
```kconfig
# Copyright (c) 2025 Muhammad Waleed Badar
# SPDX-License-Identifier: Apache-2.0

rsource "net/Kconfig"
```

## subsys/net/lib/requests/Kconfig
```kconfig
# Copyright (c) 2025 Muhammad Waleed Badar
# SPDX-License-Identifier: Apache-2.0

menuconfig REQUESTS
	bool "Enable Requests library Support"
	select HTTP_CLIENT
	select DNS_RESOLVER
	select NET_CONNECTION_MANAGER
	help
	  Enable the requests library for performing HTTP(S) requests.

if REQUESTS

menu "Requests Configuration"

module = REQUESTS
module-str = requests
source "subsys/logging/Kconfig.template.log_config"

config REQUESTS_URL_LEN
	int "Default URL lenght"
	default 128
	help
	  The default URL lenght used for HTTP requests.

config REQUESTS_SSL_CERTS
	string "Select SSL Certificate"
	help
	  The default SSL Certificate used for requests.

config REQUESTS_SHELL
	bool "Enable shell commands"
	depends on SHELL
	select LOG
	help
	  Enable Zephyr shell commands for the Requests library.
	  This allows you to perform HTTP GET and POST requests directly
	  from the Zephyr shell, e.g.:
	    uart:~$ requests get http://google.com/

if REQUESTS_SHELL

config SHELL_STACK_SIZE
	default 4096

config SHELL_WILDCARD
	default n

endif # REQUESTS_SHELL

endmenu

endif # REQUESTS
```

## west.yml
```yaml
# Copyright (c) 2025 Muhammad Waleed Badar
# SPDX-License-Identifier: Apache-2.0

manifest:
  remotes:
    - name: zephyrproject-rtos
      url-base: https://github.com/zephyrproject-rtos

  projects:
    - name: zephyr
      remote: zephyrproject-rtos
      revision: main
      import:
        # By using name-allowlist we can clone only the modules that are
        # strictly needed by the application.
        name-allowlist:
          - picolibc
          - mbedtls
          - hal_espressif
```
